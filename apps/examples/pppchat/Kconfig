## apps/examples/pppchat/Kconfig
```kconfig
#
# For a description of the syntax of this configuration file,
# see misc/tools/kconfig-language.txt.
#

config EXAMPLES_PPPCHAT
	bool "PPP Chat example"
	default n
	---help---
		Enable the PPP Chat application

if EXAMPLES_PPPCHAT
endif
```
